## app/distance_display/build/Kconfig/boards/Kconfig.defconfig
```kconfig
# Load Zephyr board defconfig descriptions.
osource "C:/Users/SabrinaSimkhovich2/zephProjects/zephyrproject/zephyr/boards/nxp/frdm_mcxn947/Kconfig.defconfig"
```

## app/touch_screen_test/build/Kconfig/boards/Kconfig.frdm_mcxn947
```kconfig
# Load board Kconfig descriptions.
osource "C:/Users/SabrinaSimkhovich2/zephProjects/zephyrproject/zephyr/boards/nxp/frdm_mcxn947/Kconfig.frdm_mcxn947"
```
